## prj.conf
```kconfig
# nothing here
CONFIG_ARC_INIT=y
CONFIG_STDOUT_CONSOLE=y
CONFIG_NEWLIB_LIBC=y
CONFIG_GPIO=y
CONFIG_MRAA=y
CONFIG_SPI=y
CONFIG_SPI_QMSI=y
CONFIG_MRAA_SPI=y
CONFIG_MRAA_GPIO=y
CONFIG_UPM=y
CONFIG_GPIO_QMSI=y
# CONFIG_PINMUX_QUARK_MCU is not set
CONFIG_UPM_utilities=y

CONFIG_UPM_sx127x_mac=y
```

## src/sx127x.c
```c
#include <zephyr.h>
#include <misc/printk.h>

#include <unistd.h>
#include <stdio.h>
#include <stdlib.h>
#include <string.h>

#include <stdint.h>
#include <math.h>
#include "upm.h"
#include "mraa.h"
#include "sx127x.h"
#include "upm_utilities.h"
#include "sx127x_mac.h"

#define TX_OUTPUT_POWER                             20        // dBm

#define LORA_BANDWIDTH                              0         // [0: 125 kHz,
                                                              //  1: 250 kHz,
                                                              //  2: 500 kHz,
                                                              //  3: Reserved]
#define LORA_SPREADING_FACTOR                       7         // [SF7..SF12]
#define LORA_CODINGRATE                             1         // [1: 4/5,
                                                              //  2: 4/6,
                                                              //  3: 4/7,
                                                              //  4: 4/8]
#define LORA_PREAMBLE_LENGTH                        8         // Same for Tx and Rx
#define LORA_SYMBOL_TIMEOUT                         5         // Symbols
#define LORA_FIX_LENGTH_PAYLOAD_ON                  false
#define LORA_IQ_INVERSION_ON                        false

/*!
 * Mote device IEEE EUI (big endian)
 *
 * \remark In this application the value is automatically generated by calling
 *         BoardGetUniqueId function
 */
//uint8_t LORAWAN_DEVICE_EUI[8] =                         { 0x01, 0x02, 0x03, 0x04, 0x05, 0x06, 0x07, 0x08 };
uint8_t LORAWAN_DEVICE_EUI[8] =                         { 0x08, 0x07, 0x06, 0x05, 0x04, 0x03, 0x02, 0x01 };

/*!
 * Application IEEE EUI (big endian)
 */
//uint8_t LORAWAN_APPLICATION_EUI[8] =                     { 0x01, 0x02, 0x03, 0x04, 0x05, 0x06, 0x07, 0x08 };
uint8_t LORAWAN_APPLICATION_EUI[8] =                     { 0x08, 0x07, 0x06, 0x05, 0x04, 0x03, 0x02, 0x01 };

/*!
 * AES encryption/decryption cipher application key
 */
//uint8_t LORAWAN_APPLICATION_KEY[16] =                     { 0x2B, 0x7E, 0x15, 0x16, 0x28, 0xAE, 0xD2, 0xA6, 0xAB, 0xF7, 0x15, 0x88, 0x09, 0xCF, 0x4F, 0x3C };
uint8_t LORAWAN_APPLICATION_KEY[16] =                     { 0x01, 0x02, 0x03, 0x04, 0x05, 0x06, 0x07, 0x08, 0x09, 0x10, 0x11, 0x12, 0x13, 0x14, 0x15, 0x16 };

int counter = 0;

uint8_t buffer[25] = {0};

void main() {
    printf("LoRa Sender\n");

    // start initialization
    //LoRaClass();

    // call pinset
    // ss, reset, dio0
    // 101
    //setPins(10, 3, 2);
    // c1000
    //setPins(60, 82, 72);

    // complete initialization by finishing pin setup and
    // setting frequency
    //init(915e6);
    //init(9041e5);
    //begin(914984144);
    //SX1276SetTxConfig(MODEM_LORA, TX_OUTPUT_POWER, 0, LORA_BANDWIDTH,
    //                  LORA_SPREADING_FACTOR, LORA_CODINGRATE,
    //                  LORA_PREAMBLE_LENGTH, LORA_FIX_LENGTH_PAYLOAD_ON,
    //                  true, 0, 0, LORA_IQ_INVERSION_ON, 3000);

    //SX1276SetPublicNetwork(true);

    //dumpRegisters();

    lorawan_init();
    lorawan_set_dev_eui(LORAWAN_DEVICE_EUI);
    lorawan_set_app_eui(LORAWAN_APPLICATION_EUI);
    lorawan_set_app_key(LORAWAN_APPLICATION_KEY);
#if 1
    //while(1) {
        //printf("sending packet: %d\n", counter);
        // adding ping here
        //snprintf(buffer, 25, "Ping from Abhishek %d", counter++);
        //SX1276Send(buffer, 25);
        lorawan_otaa_join();

// ORIGINAL CODE ** WORKS **
#if 0
        // send packet actually
        beginPacket(false);
        //printf("packet sent: ")
        snprintf(buffer, 10, "Ping %d", counter++);
        printf("buffer: %s\n", buffer);
        write_buf(buffer, 10);
        endPacket();
#endif

        counter++;
/*
        upm_delay_us(4000000);

        setFrequency(9245e5);

// GOLDEN SETTINGS
        SX1276SetRxConfig(MODEM_LORA, 2, 10,
                      LORA_CODINGRATE, 0, LORA_PREAMBLE_LENGTH,
                      8, LORA_FIX_LENGTH_PAYLOAD_ON,
                      0, false, 0, 0, true, true);

        SX1276SetRx(8000);
*/
    //}
#endif
    return;
}
```
