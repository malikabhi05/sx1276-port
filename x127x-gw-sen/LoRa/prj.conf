## prj.conf
```kconfig
# nothing here
CONFIG_ARC_INIT=y
CONFIG_STDOUT_CONSOLE=y
CONFIG_NEWLIB_LIBC=y
CONFIG_GPIO=y
CONFIG_MRAA=y
CONFIG_SPI=y
CONFIG_SPI_QMSI=y
CONFIG_MRAA_SPI=y
CONFIG_MRAA_GPIO=y
CONFIG_UPM=y
CONFIG_GPIO_QMSI=y
# CONFIG_PINMUX_QUARK_MCU is not set
CONFIG_UPM_utilities=y

CONFIG_IPM=y
CONFIG_IPM_QUARK_SE=y
CONFIG_IPM_QUARK_SE_MASTER=y
CONFIG_IPM_CONSOLE_RECEIVER=y
CONFIG_TIMESLICE_SIZE=1
CONFIG_MAIN_STACK_SIZE=2048

CONFIG_UPM_sx127x_mac=y
#CONFIG_DEBUG=y
#CONFIG_ASSERT=y



# ISSM_CONFIGURATION
# Enable OS Awareness
CONFIG_DEBUG_TRACING_KERNEL_OBJECTS=y
CONFIG_THREAD_MONITOR=y
CONFIG_GDB_INFO=y

# Configure platform
//CONFIG_ARC_INIT=n
//CONFIG_ARC_INIT_DEBUG=n
//CONFIG_ARC_GDB_ENABLE=n
```

## prj_single.conf
```kconfig
CONFIG_MULTITHREADING=n


# ISSM_CONFIGURATION
# Enable OS Awareness
CONFIG_DEBUG_TRACING_KERNEL_OBJECTS=y
CONFIG_THREAD_MONITOR=y
CONFIG_GDB_INFO=y

# Configure platform
CONFIG_ARC_INIT=n
CONFIG_ARC_INIT_DEBUG=n
CONFIG_ARC_GDB_ENABLE=n
```

## src/sx127x.c
```c
#include <zephyr.h>
#include <misc/printk.h>

#include <unistd.h>
#include <stdio.h>
#include <stdlib.h>
#include <string.h>
#include <ipm.h>
#include <ipm/ipm_quark_se.h>

#include <stdint.h>
#include <math.h>
#include "upm.h"
#include "mraa.h"
#include "sx127x.h"
#include "upm_utilities.h"
#include "sx127x_mac.h"

QUARK_SE_IPM_DEFINE(req_queue, 0, QUARK_SE_IPM_INBOUND);
//QUARK_SE_IPM_DEFINE(resp_queue, 1, QUARK_SE_IPM_INBOUND);

#define PINGTIME 1000
#define STACKSIZE 2000

#define TX_OUTPUT_POWER                             20        // dBm

#define LORA_BANDWIDTH                              0         // [0: 125 kHz,
                                                              //  1: 250 kHz,
                                                              //  2: 500 kHz,
                                                              //  3: Reserved]
#define LORA_SPREADING_FACTOR                       7         // [SF7..SF12]
#define LORA_CODINGRATE                             1         // [1: 4/5,
                                                              //  2: 4/6,
                                                              //  3: 4/7,
                                                              //  4: 4/8]
#define LORA_PREAMBLE_LENGTH                        8         // Same for Tx and Rx
#define LORA_SYMBOL_TIMEOUT                         5         // Symbols
#define LORA_FIX_LENGTH_PAYLOAD_ON                  false
#define LORA_IQ_INVERSION_ON                        false

/*!
 * Mote device IEEE EUI (big endian)
 *
 * \remark In this application the value is automatically generated by calling
 *         BoardGetUniqueId function
 */
//uint8_t LORAWAN_DEVICE_EUI[8] =                         { 0x01, 0x02, 0x03, 0x04, 0x05, 0x06, 0x07, 0x08 };
uint8_t LORAWAN_DEVICE_EUI[8] =                         { 0x08, 0x07, 0x06, 0x05, 0x04, 0x03, 0x02, 0x01 };

/*!
 * Application IEEE EUI (big endian)
 */
//uint8_t LORAWAN_APPLICATION_EUI[8] =                     { 0x01, 0x02, 0x03, 0x04, 0x05, 0x06, 0x07, 0x08 };
uint8_t LORAWAN_APPLICATION_EUI[8] =                     { 0x08, 0x07, 0x06, 0x05, 0x04, 0x03, 0x02, 0x01 };

/*!
 * AES encryption/decryption cipher application key
 */
//uint8_t LORAWAN_APPLICATION_KEY[16] =                     { 0x2B, 0x7E, 0x15, 0x16, 0x28, 0xAE, 0xD2, 0xA6, 0xAB, 0xF7, 0x15, 0x88, 0x09, 0xCF, 0x4F, 0x3C };
uint8_t LORAWAN_APPLICATION_KEY[16] =                     { 0x01, 0x02, 0x03, 0x04, 0x05, 0x06, 0x07, 0x08, 0x09, 0x10, 0x11, 0x12, 0x13, 0x14, 0x15, 0x16 };

int counter = 0;

uint8_t buffer[25] = {0};

volatile int req_ready;
volatile uint32_t value[3];


/*
void req_thread(void *arg1, void *arg2, void *arg3) {
	ARG_UNUSED(arg1);
	ARG_UNUSED(arg2);
	ARG_UNUSED(arg3);

	struct device *ipm = device_get_binding("req_queue");

	while(1) {
        k_sleep(1000);
        //printf("***********SENDING MESSAGE************\n");
        if(req_ready == 1){
        	ipm_send(ipm, 1, 0, &xxx, 12);
        	printf("*********MESSAGE SENT************\n");
        	req_ready = 0;
        }
	}
}
*/

void retrieveData(void *context, uint32_t id, volatile void *data) {
	//char *datac = (char *)data;
	value[0] = *(int *)data;
	value[1] = *(int *)(data+4);
	value[2] = *(int *)(data+8);
	//printf("INSIDE ARC\n");
	printk("%d %d %d\n", value[0], value[1], value[2]);
	//printk("*****************************************\n");
}


void main() {
    printf("LoRa Sender\n");

    req_ready = 0;
    //k_thread_spawn(&thread_stacks[0][0], STACKSIZE, req_thread, 0, 0, 0, K_PRIO_COOP(REQ_FIBER_PRE), 0, 0);
    //struct device *ipm = device_get_binding("req_queue");
    struct device *ipm;
	ipm = device_get_binding("req_queue");
	ipm_register_callback(ipm, retrieveData, NULL);
    ipm_set_enabled(ipm, 1);

    lorawan_init();
    lorawan_set_dev_eui(LORAWAN_DEVICE_EUI);
    lorawan_set_app_eui(LORAWAN_APPLICATION_EUI);
    lorawan_set_app_key(LORAWAN_APPLICATION_KEY);

    lorawan_otaa_join();
    // give some gap after join
    // this gap is for the two rx windows
    while(1) {
        upm_delay_us(4000000);

        snprintf(buffer, 25, "Ping: %d, Data: %d", counter++, value[1]);
        //req_ready = 1;

        lorawan_transmit_packet(buffer, 25);


        counter++;
        upm_delay_us(10000000);
    }
    return;
}
```
